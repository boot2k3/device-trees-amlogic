#include "gxl_p231_2g.dts"

/{
	le-dt-id = "gxl_p231_vero4kplus";

	sysled {
		led_gpio = <&gpio_ao GPIOAO_9 GPIO_ACTIVE_HIGH>;
	};

	ethmac: ethernet@0xc9410000 {
		compatible = "amlogic, gxbb-rgmii-dwmac";
		interrupts = <0 8 1>;
		phy-mode= "rgmii";
		pinctrl-names = "external_eth_pins";
		pinctrl-0 = <&external_eth_pins>;
		rst_pin-gpios = <&gpio GPIOZ_14 0>;
		GPIOZ4_pin-gpios = <&gpio GPIOZ_4 0>;
		GPIOZ5_pin-gpios = <&gpio GPIOZ_5 0>;
		mc_val = <0x1621>;
		interrupt-names = "macirq";
		internal_phy=<0>;
	};
};
